## conf/distro/include/oasis-package.ipk.inc
```bitbake
INHERIT += "package_ipk"

OASIS_FEED_CONFIGS ?= "oasis-feed-configs"

EXTRAOPKGCONFIG = "opkg-config-base ${OASIS_FEED_CONFIGS}"

OASIS_IPK_UPDATE_ALTERNATIVES ?= "update-alternatives-opkg"

DISTRO_UPDATE_ALTERNATIVES = "${OASIS_IPK_UPDATE_ALTERNATIVES}"

# we need the same provider for opkg and u-a
PREFERRED_PROVIDER_virtual/update-alternatives-native ?= "opkg-utils-native"
PREFERRED_PROVIDER_virtual/update-alternatives = "opkg-utils"
VIRTUAL-RUNTIME_update-alternatives = "${OASIS_IPK_UPDATE_ALTERNATIVES}"
```

## conf/distro/oasis.conf
```bitbake
#@--------------------------------------------------------------------
#@TYPE: Distribution
#@NAME: OASIS <http://github.com/eigendude/OASIS>
#@DESCRIPTION: OASIS, a smart home operating system based on ROS 2
#@MAINTAINER: Garrett Brown <eigendebugger@gmail.com>
#@--------------------------------------------------------------------

# Preserve original DISTRO value
USERDISTRO := "${DISTRO}"
DISTRO = "oasis"
DISTRO_NAME = "OASIS"

BUILDNAME = "OASIS ${DISTRO_VERSION}"

TARGET_VENDOR = "-oasis"
SDK_VENDOR = "-oasissdk"

DISTRO_VERSION = "v2021.06"

require conf/distro/include/oasis-preferred-versions.inc

#Images built can have to modes:
# 'debug': empty rootpassword, strace included
# 'release' no root password, no strace and gdb by default
DISTRO_TYPE ?= "debug"
#DISTRO_TYPE = "release"

# Set the toolchain type (internal, external) and brand (generic, csl etc.)
TOOLCHAIN_TYPE ?= "internal"
TOOLCHAIN_BRAND ?= ""

# Ship just basic locale by default. Locales are big (~1Mb uncompr.), so
# shipping some adhoc subset will be still useless and size burden for
# users of all other languages/countries. Instead, worth to make it easy
# to install additional languages: installer/wizard + metapackages which
# will RRECOMMEND as much as possible content for a given language
# (locales, UI transalations, help, etc. - useless for pros, but really
# helpful for common users).
# Also, it appears that no locales fit in 16Mb for now. "C" locale rules!
ROOT_FLASH_SIZE ??= "32"
IMAGE_LINGUAS ?= "en-us"

# set feed path variables
FEED_BASEPATH = "feeds/${DISTRO_VERSION}/${OASIS_PKG_FORMAT}/${TCLIBC}/"


#Everybody else can just use this:
OASIS_GCC_VERSION                                ?= "8.%"
OASIS_BINUTILS_VERSION                           ?= "2.32%"
OASIS_GDB_VERSION                                ?= "8.%"

PREFERRED_VERSION_cross-localedef-native         ?= "2.2%"

OASIS_QEMU_VERSION                               ?= "2%"

GCCVERSION                                       = "${OASIS_GCC_VERSION}"
BINUVERSION                                      = "${OASIS_BINUTILS_VERSION}"
GDBVERSION                                       = "${OASIS_GDB_VERSION}"
PREFERRED_VERSION_qemu                           = "${OASIS_QEMU_VERSION}"
PREFERRED_VERSION_qemu-native                    = "${OASIS_QEMU_VERSION}"
PREFERRED_VERSION_nativesdk-qemu                 = "${OASIS_QEMU_VERSION}"

PREFERRED_PROVIDER_dbus-glib                     = "dbus-glib"
PREFERRED_PROVIDER-gconf-dbus                    = "gconf"
PREFERRED_PROVIDER_hotplug                       = "systemd"
PREFERRED_PROVIDER_opkg                          ?= "opkg"
PREFERRED_PROVIDER_opkg-native                   ?= "opkg-native"

# Prefer systemd-boot over grub
EFI_PROVIDER                                     = "systemd-boot"

# blacklist policy

PNBLACKLIST[pn-fso-apm]       = "regular apmd is good enough"
PNBLACKLIST[gconf-dbus]        = "gconf-dbus has been merged back into main GConf"
PNBLACKLIST[gconf-dbus-native] = "gconf-dbus has been merged back into main GConf"

# Define splash before it gets set to empty in oasis-core-tweaks.inc:
SPLASH ?= ' ${@bb.utils.contains("MACHINE_FEATURES", "screen", "dietsplash", "",d)}'
require conf/distro/include/oasis.inc

# Prefer openssh over dropbear
TASK_BASIC_SSHDAEMON = "openssh-ssh openssh-sshd openssh-scp openssh-sftp openssh-sftp-server"

# Toolchain virtuals:
require conf/distro/include/toolchain-${TOOLCHAIN_TYPE}.inc
# Processor specific tunes like hard float ABI
include conf/distro/include/${TARGET_ARCH}-defaults.inc
# Set DISTRO_FEED_CONFIGS to our config var, assigned in the above .inc
DISTRO_FEED_CONFIGS = "${OASIS_FEED_CONFIGS}"

# If we're using an .ipk based rootfs, we want to have opkg installed so postinst script can run
# We also take this opportunity to inject oasis-version and the feed configs into the rootfs
IPKG_VARIANT = "opkg oasis-version ${OASIS_FEED_CONFIGS}"

# Select xserver-xorg as default, since kdrive has been EOL'ed
XSERVER ?= "xserver-xorg xf86-input-evdev xf86-input-keyboard xf86-input-mouse xf86-video-fbdev"

# do some packagegroup-base stuff here

# Prefer bluez4, it's needed for things like connman. Bluez4 is also largely backward compatible with
# bluez 3.x
DISTRO_BLUETOOTH_MANAGER = "\
	blueprobe \
	bluez5 \
   "

# We want to ship extra debug utils in the rootfs when doing a debug build
DEBUG_APPS ?= ""
DEBUG_APPS += '${@oe.utils.conditional("DISTRO_TYPE", "release", "", "strace procps",d)}'

# This hooks into packagegroup-base, so it won't do anything if your images doesn't include packagegroup-base.
# oasis-version: ship this to have an identifiable rootfs so user can report bugs against a specific version
# OASIS_FEED_CONFIGS: configfiles for the online feeds
# util-linux-mount util-linux-umount: busybox mount is broken
# oasis-libc-fixup-hack: fixes an obscure bug with libc.so symlink
DISTRO_EXTRA_RDEPENDS += "\
    oasis-version \
    ${OASIS_FEED_CONFIGS} \
    util-linux-mount util-linux-umount \
    "

# This also hooks into packagegroup-base, but isn't mandatory.
# If you don't want parts of this in your packagegroup-base using images you can put this in the image recipe:
# BAD_RECOMMENDATIONS = "avahi-daemon avahi-autoipd"
# Note that BAD_RECOMMENDATIONS is a feature of rootfs_ipk.bbclass, not OASIS
# kernel modules: ship fs modules so you can mount stuff and af-packet so networking works
# avahi: makes finding your device on the network a lot easier
# openssh-sftp-server: provides sftp which combined with avahi makes it real easy to use things like sshfs
# psplash-oasis: oasis branded psplash, you can add your own psplash-foo to an image, it uses update-alternatives
# DEBUG_APPS: ship strace and procpc to make simple debugging a lot easier
DISTRO_EXTRA_RRECOMMENDS += " \
    kernel-module-vfat \
    kernel-module-ext2 \
    kernel-module-ext3 \
    kernel-module-af-packet \
    avahi-daemon \
    avahi-autoipd \
    openssh-sftp-server \
    ${DEBUG_APPS} \
"
VIRTUAL-RUNTIME_init_manager = "systemd"
# Uncomment to completely disable support for sysv scripts:
#PACKAGECONFIG_pn-systemd = "xz"

# Enable systemd support in kernels
KERNEL_ENABLE_CGROUPS = "1"

# USE-flag like features
DISTRO_FEATURES += "tk"
DISTRO_FEATURES += "x11"
DISTRO_FEATURES += "3g"
DISTRO_FEATURES += "pulseaudio"

# OpenGL support
DISTRO_FEATURES += "opengl"

# Enable wayland
DISTRO_FEATURES += "wayland"

# Inherit the default LIBC features superset from OE-core
DISTRO_FEATURES += "${DISTRO_FEATURES_LIBC}"
```
